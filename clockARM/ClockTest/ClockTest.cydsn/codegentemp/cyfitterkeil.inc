#ifndef INCLUDED_CYFITTERKEIL_INC
#define INCLUDED_CYFITTERKEIL_INC
$INCLUDE (cydevicekeil.inc)
$INCLUDE (cydevicekeil_trm.inc)

; Counter_1_CounterHW
Counter_1_CounterHW__CAP0 EQU CYREG_TMR0_CAP0
Counter_1_CounterHW__CAP1 EQU CYREG_TMR0_CAP1
Counter_1_CounterHW__CFG0 EQU CYREG_TMR0_CFG0
Counter_1_CounterHW__CFG1 EQU CYREG_TMR0_CFG1
Counter_1_CounterHW__CFG2 EQU CYREG_TMR0_CFG2
Counter_1_CounterHW__CNT_CMP0 EQU CYREG_TMR0_CNT_CMP0
Counter_1_CounterHW__CNT_CMP1 EQU CYREG_TMR0_CNT_CMP1
Counter_1_CounterHW__PER0 EQU CYREG_TMR0_PER0
Counter_1_CounterHW__PER1 EQU CYREG_TMR0_PER1
Counter_1_CounterHW__PM_ACT_CFG EQU CYREG_PM_ACT_CFG3
Counter_1_CounterHW__PM_ACT_MSK EQU 0x01
Counter_1_CounterHW__PM_STBY_CFG EQU CYREG_PM_STBY_CFG3
Counter_1_CounterHW__PM_STBY_MSK EQU 0x01
Counter_1_CounterHW__RT0 EQU CYREG_TMR0_RT0
Counter_1_CounterHW__RT1 EQU CYREG_TMR0_RT1
Counter_1_CounterHW__SR0 EQU CYREG_TMR0_SR0

; Clock_1
Clock_1__CFG0 EQU CYREG_CLKDIST_DCFG0_CFG0
Clock_1__CFG1 EQU CYREG_CLKDIST_DCFG0_CFG1
Clock_1__CFG2 EQU CYREG_CLKDIST_DCFG0_CFG2
Clock_1__CFG2_SRC_SEL_MASK EQU 0x07
Clock_1__PM_ACT_CFG EQU CYREG_PM_ACT_CFG2
Clock_1__PM_ACT_MSK EQU 0x01
Clock_1__PM_STBY_CFG EQU CYREG_PM_STBY_CFG2
Clock_1__PM_STBY_MSK EQU 0x01

; Clock_2
Clock_2__CFG0 EQU CYREG_CLKDIST_DCFG1_CFG0
Clock_2__CFG1 EQU CYREG_CLKDIST_DCFG1_CFG1
Clock_2__CFG2 EQU CYREG_CLKDIST_DCFG1_CFG2
Clock_2__CFG2_SRC_SEL_MASK EQU 0x07
Clock_2__PM_ACT_CFG EQU CYREG_PM_ACT_CFG2
Clock_2__PM_ACT_MSK EQU 0x02
Clock_2__PM_STBY_CFG EQU CYREG_PM_STBY_CFG2
Clock_2__PM_STBY_MSK EQU 0x02

; MAGNET
MAGNET__0__MASK EQU 0x80
MAGNET__0__PC EQU CYREG_PRT1_PC7
MAGNET__0__PORT EQU 1
MAGNET__0__SHIFT EQU 7
MAGNET__AG EQU CYREG_PRT1_AG
MAGNET__AMUX EQU CYREG_PRT1_AMUX
MAGNET__BIE EQU CYREG_PRT1_BIE
MAGNET__BIT_MASK EQU CYREG_PRT1_BIT_MASK
MAGNET__BYP EQU CYREG_PRT1_BYP
MAGNET__CTL EQU CYREG_PRT1_CTL
MAGNET__DM0 EQU CYREG_PRT1_DM0
MAGNET__DM1 EQU CYREG_PRT1_DM1
MAGNET__DM2 EQU CYREG_PRT1_DM2
MAGNET__DR EQU CYREG_PRT1_DR
MAGNET__INP_DIS EQU CYREG_PRT1_INP_DIS
MAGNET__LCD_COM_SEG EQU CYREG_PRT1_LCD_COM_SEG
MAGNET__LCD_EN EQU CYREG_PRT1_LCD_EN
MAGNET__MASK EQU 0x80
MAGNET__PORT EQU 1
MAGNET__PRT EQU CYREG_PRT1_PRT
MAGNET__PRTDSI__CAPS_SEL EQU CYREG_PRT1_CAPS_SEL
MAGNET__PRTDSI__DBL_SYNC_IN EQU CYREG_PRT1_DBL_SYNC_IN
MAGNET__PRTDSI__OE_SEL0 EQU CYREG_PRT1_OE_SEL0
MAGNET__PRTDSI__OE_SEL1 EQU CYREG_PRT1_OE_SEL1
MAGNET__PRTDSI__OUT_SEL0 EQU CYREG_PRT1_OUT_SEL0
MAGNET__PRTDSI__OUT_SEL1 EQU CYREG_PRT1_OUT_SEL1
MAGNET__PRTDSI__SYNC_OUT EQU CYREG_PRT1_SYNC_OUT
MAGNET__PS EQU CYREG_PRT1_PS
MAGNET__SHIFT EQU 7
MAGNET__SLW EQU CYREG_PRT1_SLW

; PRISM
PRISM_sC16_PrISMdp_u0__16BIT_A0_REG EQU CYREG_B1_UDB08_09_A0
PRISM_sC16_PrISMdp_u0__16BIT_A1_REG EQU CYREG_B1_UDB08_09_A1
PRISM_sC16_PrISMdp_u0__16BIT_D0_REG EQU CYREG_B1_UDB08_09_D0
PRISM_sC16_PrISMdp_u0__16BIT_D1_REG EQU CYREG_B1_UDB08_09_D1
PRISM_sC16_PrISMdp_u0__16BIT_DP_AUX_CTL_REG EQU CYREG_B1_UDB08_09_ACTL
PRISM_sC16_PrISMdp_u0__16BIT_F0_REG EQU CYREG_B1_UDB08_09_F0
PRISM_sC16_PrISMdp_u0__16BIT_F1_REG EQU CYREG_B1_UDB08_09_F1
PRISM_sC16_PrISMdp_u0__A0_A1_REG EQU CYREG_B1_UDB08_A0_A1
PRISM_sC16_PrISMdp_u0__A0_REG EQU CYREG_B1_UDB08_A0
PRISM_sC16_PrISMdp_u0__A1_REG EQU CYREG_B1_UDB08_A1
PRISM_sC16_PrISMdp_u0__D0_D1_REG EQU CYREG_B1_UDB08_D0_D1
PRISM_sC16_PrISMdp_u0__D0_REG EQU CYREG_B1_UDB08_D0
PRISM_sC16_PrISMdp_u0__D1_REG EQU CYREG_B1_UDB08_D1
PRISM_sC16_PrISMdp_u0__DP_AUX_CTL_REG EQU CYREG_B1_UDB08_ACTL
PRISM_sC16_PrISMdp_u0__F0_F1_REG EQU CYREG_B1_UDB08_F0_F1
PRISM_sC16_PrISMdp_u0__F0_REG EQU CYREG_B1_UDB08_F0
PRISM_sC16_PrISMdp_u0__F1_REG EQU CYREG_B1_UDB08_F1
PRISM_sC16_PrISMdp_u1__16BIT_A0_REG EQU CYREG_B1_UDB09_10_A0
PRISM_sC16_PrISMdp_u1__16BIT_A1_REG EQU CYREG_B1_UDB09_10_A1
PRISM_sC16_PrISMdp_u1__16BIT_D0_REG EQU CYREG_B1_UDB09_10_D0
PRISM_sC16_PrISMdp_u1__16BIT_D1_REG EQU CYREG_B1_UDB09_10_D1
PRISM_sC16_PrISMdp_u1__16BIT_DP_AUX_CTL_REG EQU CYREG_B1_UDB09_10_ACTL
PRISM_sC16_PrISMdp_u1__16BIT_F0_REG EQU CYREG_B1_UDB09_10_F0
PRISM_sC16_PrISMdp_u1__16BIT_F1_REG EQU CYREG_B1_UDB09_10_F1
PRISM_sC16_PrISMdp_u1__A0_A1_REG EQU CYREG_B1_UDB09_A0_A1
PRISM_sC16_PrISMdp_u1__A0_REG EQU CYREG_B1_UDB09_A0
PRISM_sC16_PrISMdp_u1__A1_REG EQU CYREG_B1_UDB09_A1
PRISM_sC16_PrISMdp_u1__D0_D1_REG EQU CYREG_B1_UDB09_D0_D1
PRISM_sC16_PrISMdp_u1__D0_REG EQU CYREG_B1_UDB09_D0
PRISM_sC16_PrISMdp_u1__D1_REG EQU CYREG_B1_UDB09_D1
PRISM_sC16_PrISMdp_u1__DP_AUX_CTL_REG EQU CYREG_B1_UDB09_ACTL
PRISM_sC16_PrISMdp_u1__F0_F1_REG EQU CYREG_B1_UDB09_F0_F1
PRISM_sC16_PrISMdp_u1__F0_REG EQU CYREG_B1_UDB09_F0
PRISM_sC16_PrISMdp_u1__F1_REG EQU CYREG_B1_UDB09_F1
PRISM_sC16_PrISMdp_u1__MSK_DP_AUX_CTL_REG EQU CYREG_B1_UDB09_MSK_ACTL
PRISM_sC16_PrISMdp_u1__PER_DP_AUX_CTL_REG EQU CYREG_B1_UDB09_MSK_ACTL
PRISM_SyncCtl_ControlReg__0__MASK EQU 0x01
PRISM_SyncCtl_ControlReg__0__POS EQU 0
PRISM_SyncCtl_ControlReg__1__MASK EQU 0x02
PRISM_SyncCtl_ControlReg__1__POS EQU 1
PRISM_SyncCtl_ControlReg__16BIT_CONTROL_AUX_CTL_REG EQU CYREG_B1_UDB09_10_ACTL
PRISM_SyncCtl_ControlReg__16BIT_CONTROL_CONTROL_REG EQU CYREG_B1_UDB09_10_CTL
PRISM_SyncCtl_ControlReg__16BIT_CONTROL_COUNT_REG EQU CYREG_B1_UDB09_10_CTL
PRISM_SyncCtl_ControlReg__16BIT_COUNT_CONTROL_REG EQU CYREG_B1_UDB09_10_CTL
PRISM_SyncCtl_ControlReg__16BIT_COUNT_COUNT_REG EQU CYREG_B1_UDB09_10_CTL
PRISM_SyncCtl_ControlReg__16BIT_MASK_MASK_REG EQU CYREG_B1_UDB09_10_MSK
PRISM_SyncCtl_ControlReg__16BIT_MASK_PERIOD_REG EQU CYREG_B1_UDB09_10_MSK
PRISM_SyncCtl_ControlReg__16BIT_PERIOD_MASK_REG EQU CYREG_B1_UDB09_10_MSK
PRISM_SyncCtl_ControlReg__16BIT_PERIOD_PERIOD_REG EQU CYREG_B1_UDB09_10_MSK
PRISM_SyncCtl_ControlReg__CONTROL_AUX_CTL_REG EQU CYREG_B1_UDB09_ACTL
PRISM_SyncCtl_ControlReg__CONTROL_REG EQU CYREG_B1_UDB09_CTL
PRISM_SyncCtl_ControlReg__CONTROL_ST_REG EQU CYREG_B1_UDB09_ST_CTL
PRISM_SyncCtl_ControlReg__COUNT_REG EQU CYREG_B1_UDB09_CTL
PRISM_SyncCtl_ControlReg__COUNT_ST_REG EQU CYREG_B1_UDB09_ST_CTL
PRISM_SyncCtl_ControlReg__MASK EQU 0x03
PRISM_SyncCtl_ControlReg__MASK_CTL_AUX_CTL_REG EQU CYREG_B1_UDB09_MSK_ACTL
PRISM_SyncCtl_ControlReg__PER_CTL_AUX_CTL_REG EQU CYREG_B1_UDB09_MSK_ACTL
PRISM_SyncCtl_ControlReg__PERIOD_REG EQU CYREG_B1_UDB09_MSK

; DATA
DATA__0__MASK EQU 0x08
DATA__0__PC EQU CYREG_PRT5_PC3
DATA__0__PORT EQU 5
DATA__0__SHIFT EQU 3
DATA__AG EQU CYREG_PRT5_AG
DATA__AMUX EQU CYREG_PRT5_AMUX
DATA__BIE EQU CYREG_PRT5_BIE
DATA__BIT_MASK EQU CYREG_PRT5_BIT_MASK
DATA__BYP EQU CYREG_PRT5_BYP
DATA__CTL EQU CYREG_PRT5_CTL
DATA__DM0 EQU CYREG_PRT5_DM0
DATA__DM1 EQU CYREG_PRT5_DM1
DATA__DM2 EQU CYREG_PRT5_DM2
DATA__DR EQU CYREG_PRT5_DR
DATA__INP_DIS EQU CYREG_PRT5_INP_DIS
DATA__LCD_COM_SEG EQU CYREG_PRT5_LCD_COM_SEG
DATA__LCD_EN EQU CYREG_PRT5_LCD_EN
DATA__MASK EQU 0x08
DATA__PORT EQU 5
DATA__PRT EQU CYREG_PRT5_PRT
DATA__PRTDSI__CAPS_SEL EQU CYREG_PRT5_CAPS_SEL
DATA__PRTDSI__DBL_SYNC_IN EQU CYREG_PRT5_DBL_SYNC_IN
DATA__PRTDSI__OE_SEL0 EQU CYREG_PRT5_OE_SEL0
DATA__PRTDSI__OE_SEL1 EQU CYREG_PRT5_OE_SEL1
DATA__PRTDSI__OUT_SEL0 EQU CYREG_PRT5_OUT_SEL0
DATA__PRTDSI__OUT_SEL1 EQU CYREG_PRT5_OUT_SEL1
DATA__PRTDSI__SYNC_OUT EQU CYREG_PRT5_SYNC_OUT
DATA__PS EQU CYREG_PRT5_PS
DATA__SHIFT EQU 3
DATA__SLW EQU CYREG_PRT5_SLW

; SCLK
SCLK__0__MASK EQU 0x04
SCLK__0__PC EQU CYREG_PRT5_PC2
SCLK__0__PORT EQU 5
SCLK__0__SHIFT EQU 2
SCLK__AG EQU CYREG_PRT5_AG
SCLK__AMUX EQU CYREG_PRT5_AMUX
SCLK__BIE EQU CYREG_PRT5_BIE
SCLK__BIT_MASK EQU CYREG_PRT5_BIT_MASK
SCLK__BYP EQU CYREG_PRT5_BYP
SCLK__CTL EQU CYREG_PRT5_CTL
SCLK__DM0 EQU CYREG_PRT5_DM0
SCLK__DM1 EQU CYREG_PRT5_DM1
SCLK__DM2 EQU CYREG_PRT5_DM2
SCLK__DR EQU CYREG_PRT5_DR
SCLK__INP_DIS EQU CYREG_PRT5_INP_DIS
SCLK__LCD_COM_SEG EQU CYREG_PRT5_LCD_COM_SEG
SCLK__LCD_EN EQU CYREG_PRT5_LCD_EN
SCLK__MASK EQU 0x04
SCLK__PORT EQU 5
SCLK__PRT EQU CYREG_PRT5_PRT
SCLK__PRTDSI__CAPS_SEL EQU CYREG_PRT5_CAPS_SEL
SCLK__PRTDSI__DBL_SYNC_IN EQU CYREG_PRT5_DBL_SYNC_IN
SCLK__PRTDSI__OE_SEL0 EQU CYREG_PRT5_OE_SEL0
SCLK__PRTDSI__OE_SEL1 EQU CYREG_PRT5_OE_SEL1
SCLK__PRTDSI__OUT_SEL0 EQU CYREG_PRT5_OUT_SEL0
SCLK__PRTDSI__OUT_SEL1 EQU CYREG_PRT5_OUT_SEL1
SCLK__PRTDSI__SYNC_OUT EQU CYREG_PRT5_SYNC_OUT
SCLK__PS EQU CYREG_PRT5_PS
SCLK__SHIFT EQU 2
SCLK__SLW EQU CYREG_PRT5_SLW

; LE
LE__0__MASK EQU 0x02
LE__0__PC EQU CYREG_PRT5_PC1
LE__0__PORT EQU 5
LE__0__SHIFT EQU 1
LE__AG EQU CYREG_PRT5_AG
LE__AMUX EQU CYREG_PRT5_AMUX
LE__BIE EQU CYREG_PRT5_BIE
LE__BIT_MASK EQU CYREG_PRT5_BIT_MASK
LE__BYP EQU CYREG_PRT5_BYP
LE__CTL EQU CYREG_PRT5_CTL
LE__DM0 EQU CYREG_PRT5_DM0
LE__DM1 EQU CYREG_PRT5_DM1
LE__DM2 EQU CYREG_PRT5_DM2
LE__DR EQU CYREG_PRT5_DR
LE__INP_DIS EQU CYREG_PRT5_INP_DIS
LE__LCD_COM_SEG EQU CYREG_PRT5_LCD_COM_SEG
LE__LCD_EN EQU CYREG_PRT5_LCD_EN
LE__MASK EQU 0x02
LE__PORT EQU 5
LE__PRT EQU CYREG_PRT5_PRT
LE__PRTDSI__CAPS_SEL EQU CYREG_PRT5_CAPS_SEL
LE__PRTDSI__DBL_SYNC_IN EQU CYREG_PRT5_DBL_SYNC_IN
LE__PRTDSI__OE_SEL0 EQU CYREG_PRT5_OE_SEL0
LE__PRTDSI__OE_SEL1 EQU CYREG_PRT5_OE_SEL1
LE__PRTDSI__OUT_SEL0 EQU CYREG_PRT5_OUT_SEL0
LE__PRTDSI__OUT_SEL1 EQU CYREG_PRT5_OUT_SEL1
LE__PRTDSI__SYNC_OUT EQU CYREG_PRT5_SYNC_OUT
LE__PS EQU CYREG_PRT5_PS
LE__SHIFT EQU 1
LE__SLW EQU CYREG_PRT5_SLW

; OE
OE__0__MASK EQU 0x01
OE__0__PC EQU CYREG_PRT5_PC0
OE__0__PORT EQU 5
OE__0__SHIFT EQU 0
OE__AG EQU CYREG_PRT5_AG
OE__AMUX EQU CYREG_PRT5_AMUX
OE__BIE EQU CYREG_PRT5_BIE
OE__BIT_MASK EQU CYREG_PRT5_BIT_MASK
OE__BYP EQU CYREG_PRT5_BYP
OE__CTL EQU CYREG_PRT5_CTL
OE__DM0 EQU CYREG_PRT5_DM0
OE__DM1 EQU CYREG_PRT5_DM1
OE__DM2 EQU CYREG_PRT5_DM2
OE__DR EQU CYREG_PRT5_DR
OE__INP_DIS EQU CYREG_PRT5_INP_DIS
OE__LCD_COM_SEG EQU CYREG_PRT5_LCD_COM_SEG
OE__LCD_EN EQU CYREG_PRT5_LCD_EN
OE__MASK EQU 0x01
OE__PORT EQU 5
OE__PRT EQU CYREG_PRT5_PRT
OE__PRTDSI__CAPS_SEL EQU CYREG_PRT5_CAPS_SEL
OE__PRTDSI__DBL_SYNC_IN EQU CYREG_PRT5_DBL_SYNC_IN
OE__PRTDSI__OE_SEL0 EQU CYREG_PRT5_OE_SEL0
OE__PRTDSI__OE_SEL1 EQU CYREG_PRT5_OE_SEL1
OE__PRTDSI__OUT_SEL0 EQU CYREG_PRT5_OUT_SEL0
OE__PRTDSI__OUT_SEL1 EQU CYREG_PRT5_OUT_SEL1
OE__PRTDSI__SYNC_OUT EQU CYREG_PRT5_SYNC_OUT
OE__PS EQU CYREG_PRT5_PS
OE__SHIFT EQU 0
OE__SLW EQU CYREG_PRT5_SLW

; Miscellaneous
; -- WARNING: define names containting LEOPARD or PANTHER are deprecated and will be removed in a future release
CYDEV_CHIP_REVISION_3A_PRODUCTION EQU 3
CYDEV_CHIP_REV_LEOPARD_PRODUCTION EQU 3
CYDEV_CHIP_MEMBER_3A EQU 1
CYDEV_CHIP_FAMILY_PSOC3 EQU 1
CYDEV_CHIP_DIE_LEOPARD EQU 1
CYDEV_CHIP_DIE_EXPECT EQU CYDEV_CHIP_DIE_LEOPARD
BCLK__BUS_CLK__HZ EQU 24000000
BCLK__BUS_CLK__KHZ EQU 24000
BCLK__BUS_CLK__MHZ EQU 24
CYDEV_BOOTLOADER_CHECKSUM EQU 0
CYDEV_BOOTLOADER_CHECKSUM_BASIC EQU 0
CYDEV_BOOTLOADER_CHECKSUM_CRC EQU 1
CYDEV_BOOTLOADER_WAIT_COMMAND EQU 1
CYDEV_BOOTLOADER_WAIT_TIME EQU 10
CYDEV_CHIP_DIE_ACTUAL EQU CYDEV_CHIP_DIE_EXPECT
CYDEV_CHIP_DIE_PANTHER EQU 2
CYDEV_CHIP_DIE_UNKNOWN EQU 0
CYDEV_CHIP_FAMILY_PSOC5 EQU 2
CYDEV_CHIP_FAMILY_UNKNOWN EQU 0
CYDEV_CHIP_FAMILY_USED EQU CYDEV_CHIP_FAMILY_PSOC3
CYDEV_CHIP_JTAG_ID EQU 0x1E034069
CYDEV_CHIP_MEMBER_5A EQU 2
CYDEV_CHIP_MEMBER_UNKNOWN EQU 0
CYDEV_CHIP_MEMBER_USED EQU CYDEV_CHIP_MEMBER_3A
CYDEV_CHIP_REV_EXPECT EQU CYDEV_CHIP_REV_LEOPARD_PRODUCTION
CYDEV_CHIP_REV_LEOPARD_ES1 EQU 0
CYDEV_CHIP_REV_LEOPARD_ES2 EQU 1
CYDEV_CHIP_REV_LEOPARD_ES3 EQU 3
CYDEV_CHIP_REV_PANTHER_ES0 EQU 0
CYDEV_CHIP_REV_PANTHER_ES1 EQU 1
CYDEV_CHIP_REVISION_3A_ES1 EQU 0
CYDEV_CHIP_REVISION_3A_ES2 EQU 1
CYDEV_CHIP_REVISION_3A_ES3 EQU 3
CYDEV_CHIP_REVISION_5A_ES0 EQU 0
CYDEV_CHIP_REVISION_5A_ES1 EQU 1
CYDEV_CHIP_REVISION_USED EQU CYDEV_CHIP_REVISION_3A_PRODUCTION
CYDEV_CONFIG_FORCE_ROUTE EQU 0
CYDEV_CONFIG_UNUSED_IO EQU 0
CYDEV_CONFIGURATION_CLEAR_SRAM EQU 1
CYDEV_CONFIGURATION_COMPRESSED EQU 0
CYDEV_CONFIGURATION_DMA EQU 1
CYDEV_CONFIGURATION_ECC EQU 1
CYDEV_CONFIGURATION_IMOENABLED EQU 1
CYDEV_CONFIGURATION_MODE EQU 2
CYDEV_DEBUG_ENABLE_MASK EQU 0x01
CYDEV_DEBUG_ENABLE_REGISTER EQU CYREG_MLOGIC_DEBUG
CYDEV_DEBUGGING_DPS EQU 2
CYDEV_DEBUGGING_ENABLE EQU 1
CYDEV_DEBUGGING_REQXRES EQU 1
CYDEV_DEBUGGING_XRES EQU 0
CYDEV_ECC_ENABLE EQU 0
CYDEV_INSTRUCT_CACHE_ENABLED EQU 1
CYDEV_VDDA LIT '5.0'
CYDEV_VDDA_MV EQU 5000
CYDEV_VDDD LIT '5.0'
CYDEV_VDDD_MV EQU 5000
CYDEV_VDDIO0 LIT '5.0'
CYDEV_VDDIO0_MV EQU 5000
CYDEV_VDDIO1 LIT '5.0'
CYDEV_VDDIO1_MV EQU 5000
CYDEV_VDDIO2 LIT '5.0'
CYDEV_VDDIO2_MV EQU 5000
CYDEV_VDDIO3 LIT '5.0'
CYDEV_VDDIO3_MV EQU 5000
CYDEV_VIO0 EQU 5
CYDEV_VIO0_MV EQU 5000
CYDEV_VIO1 EQU 5
CYDEV_VIO1_MV EQU 5000
CYDEV_VIO2 EQU 5
CYDEV_VIO2_MV EQU 5000
CYDEV_VIO3 EQU 5
CYDEV_VIO3_MV EQU 5000
DMA_CHANNELS_USED__MASK0 EQU 0x00000000
CYDEV_BOOTLOADER_ENABLE EQU 0

#endif /* INCLUDED_CYFITTERKEIL_INC */
